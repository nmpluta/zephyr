## drivers/sensor/dfrobot/Kconfig
```kconfig
# Copyright (c) 2026 Iomico
# SPDX-License-Identifier: Apache-2.0

source "drivers/sensor/dfrobot/sen0466/Kconfig"
```

## drivers/sensor/dfrobot/sen0466/Kconfig
```kconfig
# Copyright (c) 2026 Iomico
# SPDX-License-Identifier: Apache-2.0

config SEN0466
	bool "DFRobot SEN0466 CO sensor"
	default y
	depends on DT_HAS_DFROBOT_SEN0466_ENABLED
	select I2C
	help
	  Enable driver for the DFRobot SEN0466 electrochemical carbon
	  monoxide sensor, reporting CO concentration in ppm and the
	  temperature of an on-board NTC over I2C.

config EMUL_SEN0466
	bool "Emulator for the DFRobot SEN0466"
	default y
	depends on SEN0466
	depends on EMUL
	help
	  Enable the emulator for the DFRobot SEN0466, so the driver can be
	  exercised without hardware.
```

## dts/bindings/sensor/dfrobot,sen0466.yaml
```yaml
# Copyright (c) 2026 Iomico
# SPDX-License-Identifier: Apache-2.0

description: |
  DFRobot SEN0466 electrochemical carbon monoxide sensor.
  Provides CO concentration and on-board temperature readings via I2C.

compatible: "dfrobot,sen0466"

include: [sensor-device.yaml, i2c-device.yaml]
```
